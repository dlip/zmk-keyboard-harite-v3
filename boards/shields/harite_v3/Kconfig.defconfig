## boards/shields/harite_v3/Kconfig.defconfig
```kconfig
if SHIELD_HARITE_V3_RIGHT

# Name must be less than 16 characters long!
config ZMK_KEYBOARD_NAME
    default "Harite v3"

config ZMK_SPLIT_ROLE_CENTRAL
    default y

endif

if SHIELD_HARITE_V3_LEFT || SHIELD_HARITE_V3_RIGHT

config ZMK_SPLIT
    default y

endif
```

## boards/shields/harite_v3/Kconfig.shield
```kconfig
# No whitespace after the comma or in your part name!
config SHIELD_HARITE_V3_LEFT
    def_bool $(shields_list_contains,harite_v3_left)

# No whitespace after the comma or in your part name!
config SHIELD_HARITE_V3_RIGHT
    def_bool $(shields_list_contains,harite_v3_right)
```

## west.yml
```yaml
manifest:
  remotes:
    - name: zmkfirmware
      url-base: https://github.com/zmkfirmware
    - name: badjeff
      url-base: https://github.com/badjeff
    - name: dlip
      url-base: https://github.com/dlip
  projects:
    - name: zmk-analog-input-driver
      remote: badjeff
      revision: a2dd1cbd7e5143b0634357aa1f48b656d0287c54  # main
    - name: zmk-pmw3610-driver
      remote: badjeff
      revision: 12d532104ff1ef2a91d264a623842ea2095926cc  # main
    - name: zmk
      remote: dlip
      revision: eeac4c3a53e6945281d5e2bb189c94b2c0bbce45  # main
      import: app/west.yml
  self:
    path: config
```
